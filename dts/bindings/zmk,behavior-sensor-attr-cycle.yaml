## dts/bindings/zmk,behavior-sensor-attr-cycle.yaml
```yaml
# Copyright (c) 2025, George Norton
# SPDX-License-Identifier: MIT

description: Sets a sensor attribute (e.g. a DPI value) by cycling through a list of values.

compatible: "zmk,behavior-sensor-attr-cycle"

include: one_param.yaml

properties:
  sensor_device:
    type: phandle
    description: >
      The target sensor device to send set_attr commands to. Optional, so that
      the same behavior node can be declared on every part of a split keyboard
      while only the part physically holding the sensor names it. Parts without
      it keep the index in step and do nothing else.
  values:
    required: true
    type: array
    description: A list of values which will be cycled through.
  attr:
    required: true
    type: int
    description: The attribute to modify.
  persistant:
    type: boolean
    description: If enabled the state will be stored to flash memory and restored at power on. This required the settings feature to be enabled and configured.
  save_delay:
    default: 2000
    type: int
    description: The time to wait before saving to flash.
  load_delay:
    default: 0
    type: int
    description: A delay before settings loaded from flash are sent to the device. Some drivers may not expect to receive attributes before they have initialised.
```
